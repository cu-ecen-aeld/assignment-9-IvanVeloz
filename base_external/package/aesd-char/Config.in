## base_external/package/aesd-char/Config.in
```kconfig
config BR2_PACKAGE_AESD_CHAR
	bool "aesd-char"
	help
	  Includes the aesd-char driver from the assignments-3-and-later repo.
	  To be used by the aesdsocket server.
```

## base_external/package/ldd/Config.in
```kconfig
config BR2_PACKAGE_LDD
	bool "ldd"
	help
	  Includes the customized ldd version from assignment 7.
	  Used to understand buildroot external trees and package builds.
```
